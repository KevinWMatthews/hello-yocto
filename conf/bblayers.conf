## conf/bblayers.conf
```bitbake
BBLAYERS ?= " \
    ${TOPDIR}/../meta-hello \
    ${TOPDIR}/../poky/meta \
    ${TOPDIR}/../poky/meta-poky \
    ${TOPDIR}/../poky/meta-yocto-bsp"
BBPATH ?= "${TOPDIR}"
BBFILES ??= ""
```

## conf/local.conf
```bitbake
# debug
IMAGE_INSTALL:append = " hello-cmake"
EXTRA_IMAGE_FEATURES = "debug-tweaks"

MACHINE ??= "qemux86-64"
DISTRO ??= "poky"
BBMULTICONFIG ?= ""
```
